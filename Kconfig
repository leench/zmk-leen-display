## Kconfig
```kconfig
rsource "drivers/input/Kconfig"

config ROTATE_DISPLAY_180
    bool "Rotate the display 180 degrees"
    default n

menu "Custom Display Widgets"

config ZMK_WIDGET_CLOCK
    bool "Clock widget"
    default y

config ZMK_WIDGET_VOLUME
    bool "Volume widget"
    default y

config ZMK_WIDGET_BATTERY
    bool "Battery widget"
    default y

config ZMK_WIDGET_LAYER
    bool "Layer widget"
    default y

config ZMK_WIDGET_CONNECTION
    bool "Connection widget"
    default y

config ZMK_WIDGET_BONGO_CAT
    bool "Bongo Cat widget"
    default n

config ZMK_WIDGET_SYSICON
    bool "System icon widget"
    default y

config ZMK_WIDGET_MODIFIERS
    bool "Modifiers widget"
    default y

config ZMK_WIDGET_WPM_STATUS
    bool "WPM status widget"
    default n

endmenu
```

## drivers/input/Kconfig
```kconfig
config INPUT_CST816D
    bool "CST816D touch controller"
    depends on I2C
    help
      Enable CST816D capacitive touch controller driver.

config INPUT_CST816D_INTERRUPT
    bool "Enable CST816D interrupt mode"
    default y
    help
      Enable interrupt mode for CST816D touch sensor.
      If disabled, the driver will fall back to polling mode.
```

## drivers/input/Kconfig.cst816d
```kconfig
# drivers/input/Kconfig.cst816d
menuconfig INPUT_CST816D
    bool "CST816D Touch Controller"
    default y
    depends on DT_HAS_HYNITRON_CST816D_ENABLED
    help
      Enable driver for Hynitron CST816D capacitive touch controller.

if INPUT_CST816D

config CONFIG_INPUT_CST816D_INTERRUPT
    int "Init priority"
    default 80
    help
      CST816D device driver initialization priority.

endif # INPUT_CST816D
```

## dts/bindings/input/hynitron,cst816d.yaml
```yaml
description: Hynitron CST816D touch controller
compatible: "hynitron,cst816d"

include: i2c-device.yaml

properties:
  reg:
    description: I2C device address
    type: array
    required: true

  irq-gpios:
    type: phandle-array
    required: true
    description: Interrupt GPIO pin

  rst-gpios:
    type: phandle-array
    required: false
    description: Reset GPIO pin
    
  rotation:
    type: int
    required: false
    description: Screen rotation in degrees (0, 90, 180, 270)
    default: 0
    enum: [0, 90, 180, 270]
    
  swap-xy:
    type: boolean
    required: false
    description: Swap X and Y coordinates
    
  invert-x:
    type: boolean
    required: false
    description: Invert X coordinate
    
  invert-y:
    type: boolean
    required: false
    description: Invert Y coordinate

  width:
    type: int
    required: false
    description: Screen width in pixels
    default: 240
    
  height:
    type: int
    required: false
    description: Screen height in pixels
    default: 240
```
