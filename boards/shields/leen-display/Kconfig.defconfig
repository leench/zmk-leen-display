## boards/shields/leen-display/Kconfig.defconfig
```kconfig
if SHIELD_LEEN_DISPLAY

choice ZMK_DISPLAY_STATUS_SCREEN
    default ZMK_DISPLAY_STATUS_SCREEN_CUSTOM
endchoice

config ZMK_DISPLAY_STATUS_SCREEN_CUSTOM
    select LV_USE_LABEL
    select LV_USE_BAR
    select LV_USE_FLEX
    select LV_USE_IMG
    select LV_USE_ANIMIMG 
    select LV_USE_ANIMATION
    select LV_COLOR_SCREEN_TRANSP
    select LV_USE_OBJ
    select LV_USE_CONT
    select LV_USE_ARC
    select ZMK_WPM
    imply ZMK_HID_INDICATORS

config ZMK_DONGLE_DISPLAY_DONGLE_BATTERY
    bool "Show also the battery level of the dongle"
    depends on BT && (!ZMK_SPLIT_BLE || ZMK_SPLIT_ROLE_CENTRAL)

choice ZMK_DISPLAY_WORK_QUEUE
    default ZMK_DISPLAY_WORK_QUEUE_DEDICATED
endchoice

config ZMK_DISPLAY_DEDICATED_THREAD_STACK_SIZE
    default 4096

choice ST7789V_PIXEL_FORMAT
	default ST7789V_RGB565
endchoice

config LV_Z_VDB_SIZE
    default 40

config LV_Z_MEM_POOL_SIZE
    default 8192

config LV_DPI_DEF
    default 261

config LV_Z_BITS_PER_PIXEL
	default 16

choice LV_COLOR_DEPTH
	default LV_COLOR_DEPTH_16
endchoice

config LV_COLOR_16_SWAP
	default y

config LV_DISP_DEF_REFR_PERIOD
    default 20

config PWM
    default y

config LED
    default y

config DONGLE_SCREEN_IDLE_TIMEOUT_S
    int "Screen Idle Timeout (Seconds)"
    default 600
    help
      The number of seconds of inactivity before the screen turns off completely to save power.
      Set to 0 to disable automatic screen off.

config DONGLE_SCREEN_IDLE_DIM_TIMEOUT_S
    int "Screen Idle Dim Timeout (Seconds)"
    default 300
    help
      The number of seconds of inactivity before the screen brightness is reduced (dimmed).
      This value must be less than DONGLE_SCREEN_IDLE_TIMEOUT_S. 
      Set to 0 or leave undefined to disable the dimming stage.

config DONGLE_SCREEN_IDLE_DIM_BRIGHTNESS
    int "Screen Idle Dim Brightness (0-100)"
    default 10
    range 0 100
    depends on DONGLE_SCREEN_IDLE_DIM_TIMEOUT_S > 0
    help
      The specific brightness level (0 to 100) the screen will fade to when 
      DONGLE_SCREEN_IDLE_DIM_TIMEOUT_S is reached.

config DONGLE_SCREEN_MAX_BRIGHTNESS
    int "Maximum screen brightness (1-100)"
    default 80
    range 1 100
    help
        This is the brightness which is used when the dongle is powered on. This is also the maximum brightness used by the dimmer.

config DONGLE_SCREEN_MIN_BRIGHTNESS
    int "Minimum screen brightness (1-99)"
    default 1
    range 1 99
    help
        Minimum screen brightness (1-99). This is the brightness used as a minimum value for brightness adjustments with the modifier keys and the ambient light sensor.

config DONGLE_SCREEN_DEFAULT_BRIGHTNESS
    int "Default screen brightness (0-100)"
    default DONGLE_SCREEN_MAX_BRIGHTNESS
    range DONGLE_SCREEN_MIN_BRIGHTNESS DONGLE_SCREEN_MAX_BRIGHTNESS
    help
      The initial brightness level for the screen backlight.
      This value is used at startup and when the screen is turned on. 
      It is defaulted to the maximum brightness but can be overridden.

config DONGLE_SCREEN_BRIGHTNESS_KEYBOARD_CONTROL
    bool "Control screen brightness via keyboard"
    default y
    help
      Allows controlling the screen brightness via keyboard (e.g. F23/F24).

config DONGLE_SCREEN_BRIGHTNESS_UP_KEYCODE
    int "Keycode for increasing screen brightness"
    default 115  # KC_F24
    help
      Keycode that increases the screen brightness (default: F23).

config DONGLE_SCREEN_BRIGHTNESS_DOWN_KEYCODE
    int "Keycode for decreasing screen brightness"
    default 114  # KC_F23
    help
      Keycode that decreases the screen brightness (default: F24).

config DONGLE_SCREEN_TOGGLE_KEYCODE
    int "Keycode for toggle screen off/on"
    default 113  # KC_F22
    help
      Keycode that toggles the screen off and on (default: F22).

config DONGLE_SCREEN_BRIGHTNESS_STEP
    int "Step for brightness adjustment with keyboard"
    default 10
    help
      How much brightness steps (range MIN_BRIGHTNESS to MAX_BRIGHTNESS) should be applied per keystroke

config DONGLE_SCREEN_BRIGHTNESS_MODIFIER
    int "The modifier to start the application with."
    default 0
    range -99 99
    help
      The modifier to start the dongle with. Useful if you found a modifier comfortable for you. Espacially for ambient light. Otherwise no need to change.

endif
```
